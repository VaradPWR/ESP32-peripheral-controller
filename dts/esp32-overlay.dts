/dts-v1/;
/plugin/;

/ {
    fragment@0 {
        target-path = "/bus@0/serial@3100000";

        __overlay__ {
            esp32 {
                compatible = "custom,esp32";
                status = "okay";
            };
        };
    };
};
